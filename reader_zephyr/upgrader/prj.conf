## CMakeLists.txt
```
cmake_minimum_required(VERSION 3.20.0)

# Initialize Zephyr
find_package(Zephyr REQUIRED HINTS $ENV{ZEPHYR_BASE})
project(upgrader)

# Include sources
target_sources(app PRIVATE src/main.cpp src/Led.cpp)

# Optional: Set additional compile options if needed
# e.g., add compile options or flags here if necessary
#target_compile_options(app PRIVATE -g -O0)  # Debugging symbols and no optimization
```

## prj.conf
```kconfig
CONFIG_HEAP_MEM_POOL_SIZE=1048
CONFIG_ASSERT=y
CONFIG_GPIO=y
CONFIG_ADC=y

CONFIG_SHELL=n
#CONFIG_ADC_SHELL=y
#CONFIG_GPIO_SHELL=y
CONFIG_SHELL_PROMPT_UART="upgrader:~$ "

CONFIG_REBOOT=y

CONFIG_LOG=y

CONFIG_EVENTS=y

CONFIG_MAIN_STACK_SIZE=2048

CONFIG_FLASH=y
CONFIG_FLASH_PAGE_LAYOUT=y
CONFIG_CRC=y


CONFIG_BOOTLOADER_MCUBOOT=y
#CONFIG_BOOT_SIGNATURE_KEY_FILE="~/keys/mykey.pem"
#CONFIG_MCUBOOT_SIGNATURE_KEY_FILE="/home/elotro/keys/mykey.pem"

CONFIG_MCUBOOT_IMGTOOL_SIGN_VERSION="0.0.2"


CONFIG_NET_BUF=y
CONFIG_ZCBOR=y

# Enable mcumgr.
CONFIG_MCUMGR=y

CONFIG_MCUBOOT_BOOTLOADER_MODE_FIRMWARE_UPDATER=y
CONFIG_MCUBOOT_APPLICATION_FIRMWARE_UPDATER=y

#CONFIG_MCUBOOT_UTIL=y
CONFIG_MCUBOOT_BOOTUTIL_LIB=y


CONFIG_STREAM_FLASH=y
CONFIG_IMG_MANAGER=y
CONFIG_MCUBOOT_IMG_MANAGER=y
CONFIG_FLASH_MAP=y

#CONFIG_MCUBOOT_SIGNATURE_KEY_FILE="/home/elotro/keys/mykey.pem"
CONFIG_MCUBOOT_GENERATE_UNSIGNED_IMAGE=y
```

## boards/chessboard_l431_v1.overlay
```dts
/ {
	chosen {
		zephyr,code-partition = &slot1_partition;
		zephyr,uart-mcumgr = &usart3;
	};

};
```

## src/main.cpp
```c
/*
 * Copyright (c) 2017 Linaro Limited
 *
 * SPDX-License-Identifier: Apache-2.0
 */


#include <zephyr/kernel.h>
#include <zephyr/device.h>
#include <zephyr/devicetree.h>
#include <zephyr/drivers/gpio.h>
#include <zephyr/drivers/adc.h>
#include <zephyr/sys/printk.h>
#include <zephyr/sys/util.h>
#include <zephyr/sys/__assert.h>
#include <zephyr/shell/shell.h>

//#include <zephyr/bootutil/bootutil_public.h>

#include <zephyr/dfu/mcuboot.h>
#include <zephyr/sys/reboot.h>

#include <string.h>
#include <ctype.h>

#include "Led.hpp"

/* size of stack area used by each thread */
#define STACKSIZE 1024

/* scheduling priority used by each thread */
#define PRIORITY_NORMAL 7
#define PRIORITY_HIGH 5

#define LED0_NODE DT_ALIAS(led0)

#if !DT_NODE_HAS_STATUS(LED0_NODE, okay)
#error "Unsupported board: led0 devicetree alias is not defined"
#endif

extern "C" int main(void)
{
    printk("Updater running (slot 1). Simulating update for 10 seconds...\n");
    k_sleep(K_SECONDS(10));

    printk("Update simulation done. Marking Slot 1 as confirmed so MCUboot returns to Slot 0.\n");

    // Tell MCUboot we are finished with Slot 1
    //boot_write_img_confirmed();
    //boot_write_img_confirmed_multi(0);
    //    boot_set_confirmed();

    printk("Rebooting to boot Slot 0...\n");
    //sys_reboot(SYS_REBOOT_COLD);


    return 0;
}
```
