## reader_zephyr/boards/arm/chessboard_l431_v1/Kconfig.chessboard_l431_v1
```kconfig
# Copyright (c) 2016 BayLibre, SAS
# SPDX-License-Identifier: Apache-2.0

config BOARD_CHESSBOARD_L431_V1
	select SOC_STM32L431XX
```

## reader_zephyr/boards/arm/chessboard_l431_v1/Kconfig.defconfig
```kconfig
# STM32L431KC Nucleo board configuration

# Copyright (c) 2016 Open-RnD Sp. z o.o.
# Copyright (c) 2016 BayLibre, SAS
# SPDX-License-Identifier: Apache-2.0

if BOARD_CHESSBOARD_L431_V1

config SPI_STM32_INTERRUPT
	default y
	depends on SPI

endif # BOARD_CHESSBOARD_L431_V1
```

## reader_zephyr/boards/arm/chessboard_l431_v1/board.yml
```yaml
board:
  name: chessboard_l431_v1
  full_name: Custom chessboard v1
  vendor: st
  socs:
    - name: stm32l431xx
```
